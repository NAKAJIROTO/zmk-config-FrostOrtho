#include "FrostOrtho.dtsi"
#include <behaviors/battery_history_request.dtsi>

&default_transform {
    col-offset = <6>;
};

&kscan0 {
    col-gpios
        = <&xiao_d 10 GPIO_ACTIVE_HIGH>
        , <&xiao_d 9 GPIO_ACTIVE_HIGH>
        , <&xiao_d 8 GPIO_ACTIVE_HIGH>
        , <&xiao_d 7 GPIO_ACTIVE_HIGH>
        , <&gpio0 10 GPIO_ACTIVE_HIGH>;
};

&zip_temp_layer {
    require-prior-idle-ms = <400>;

    excluded-positions = <
        32
    >;
};
